## meta-greenbase/conf/layer.conf
```bitbake
# We have a conf and classes directory, add to BBPATH
BBPATH .= ":${LAYERDIR}"

# We have recipes-* directories, add to BBFILES
BBFILES += "${LAYERDIR}/recipes-*/*/*.bb \
            ${LAYERDIR}/recipes-*/*/*.bbappend"

BBFILE_COLLECTIONS += "meta-greenbase"
BBFILE_PATTERN_meta-greenbase = "^${LAYERDIR}/"
BBFILE_PRIORITY_meta-greenbase = "9"

LAYERDEPENDS_meta-greenbase = "core"
LAYERSERIES_COMPAT_meta-greenbase = "kirkstone"
```

## meta-hailo-bsp/conf/machine/hailo15-base.inc
```bitbake
require hailo15-family-base.inc

HAILO_HOST_NAME ??= "hailo15"
hostname:pn-base-files = "${HAILO_HOST_NAME}"

SCU_FW_MACHINE = "${HAILO_HOST_NAME}"
SCU_BL_MACHINE = "${HAILO_HOST_NAME}"
RECOVERY_FW_MACHINE = "${HAILO_HOST_NAME}"
```

## meta-hailo-bsp/conf/machine/hailo15-veloce.conf
```bitbake
require hailo15-base.inc
require veloce.inc

SCU_FW_MACHINE = "hailo15_veloce"
SCU_BL_MACHINE = "hailo15_veloce"

UBOOT_MACHINE = "hailo15_veloce_defconfig"
```

## meta-hailo-bsp/conf/machine/hailo15l-base.inc
```bitbake
HAILO_HOST_NAME = "hailo15l"
MACHINEOVERRIDES =. "${HAILO_HOST_NAME}:"

require hailo15-base.inc
```

## meta-hailo-bsp/conf/machine/hailo15l-oregano.conf
```bitbake
require hailo15l-base.inc

SCU_FW_MACHINE = "oregano"
SCU_BL_MACHINE = "oregano"

UBOOT_MACHINE = "hailo15l_oregano_defconfig"
```

## meta-hailo-bsp/conf/machine/hailo15l-veloce.conf
```bitbake
require hailo15l-base.inc
require veloce.inc

SCU_FW_MACHINE = "hailo15l_veloce"
SCU_BL_MACHINE = "hailo15l_veloce"
RECOVERY_FW_MACHINE = "hailo15l_veloce"

UBOOT_MACHINE = "hailo15l_veloce_defconfig"
```

## meta-hailo-imaging/conf/layer.conf
```bitbake
# We have a conf and classes directory, add to BBPATH
BBPATH .= ":${LAYERDIR}"

# We have recipes-* directories, add to BBFILES
BBFILES += "${LAYERDIR}/recipes-*/*/*.bb \
            ${LAYERDIR}/recipes-*/*/*.bbappend"

BBFILE_COLLECTIONS += "meta-hailo-imaging"
BBFILE_PATTERN_meta-hailo-imaging = "^${LAYERDIR}/"
BBFILE_PRIORITY_meta-hailo-imaging = "6"

LAYERDEPENDS_meta-hailo-imaging = "core"
LAYERSERIES_COMPAT_meta-hailo-imaging = "kirkstone"

DISTRO_FEATURES:append = " x11" 

# For vc8000e encoder
KERNEL_MODULE_AUTOLOAD += "hx280enc"
```
